/*
 * CAUTION: This file is automatically generated by Xilinx.
 * Version:  
 * Today is: Tue Dec 19 15:19:59 2017
 */


/ {
    amba_pl: amba_pl {
        #address-cells = <1>;
        #size-cells = <1>;
        compatible = "simple-bus";
        ranges ;
        hkdf0: hkdf@43c00000 {
            compatible = "xlnx,hkdf-1.0";
            reg = <0x43c00000 0x10000>;
            xlnx,s-axi-axi-addr-width = <0x7>;
            xlnx,s-axi-axi-data-width = <0x20>;
        };
    };
};
